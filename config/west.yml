## config/west.yml
```yaml
manifest:
  remotes:
    - name: zmk
      url-base: https://github.com/BartHageman
    - name: urob
      url-base: https://github.com/urob
  projects:
    - name: zmk
      remote: zmk
      path: zmk
      revision: main
      import: app/west.yml
    - name: zmk-leader-key
      remote: urob
      revision: main  # Set to same version as ZMK.
    - name: zmk-helpers
      remote: urob
      revision: main
  self:
    path: config
```
